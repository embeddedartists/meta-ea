## conf/layer.conf
```bitbake
# We have a conf and classes directory, add to BBPATH
BBPATH .= ":${LAYERDIR}"

# We have a recipes directory, add to BBFILES
BBFILES += "${LAYERDIR}/recipes-*/*/*.bb \
            ${LAYERDIR}/recipes-*/*/*.bbappend"

BBFILE_COLLECTIONS += "ea"
BBFILE_PATTERN_ea = "^${LAYERDIR}/"
BBFILE_PRIORITY_ea = "9"
LAYERSERIES_COMPAT_ea = "kirkstone"

#LAYERDEPENDS_ea = "fsl-arm"

IMX_DEFAULT_BOOTLOADER_imx = "u-boot-ea"

# Avoid multiple runtime providers for u-boot-default-env
PREFERRED_RPROVIDER_u-boot-default-env ??= "${IMX_DEFAULT_BOOTLOADER}"
```

## conf/machine/imx6dlea-com.conf
```bitbake
#@TYPE: Machine
#@NAME: Embedded Artists i.MX6 DualLite COM Board
#@SOC: i.MX6DL
#@DESCRIPTION: Machine configuration for Embedded Artists i.MX6 DualLite COM Board
#@MAINTAINER: EA <imx@EmbeddedArtists.com>

require conf/machine/include/imx-base.inc
require conf/machine/include/tune-cortexa9.inc

MACHINEOVERRIDES =. "mx6:mx6dl:"

PREFERRED_PROVIDER_virtual/kernel_imx = "linux-ea"
PREFERRED_PROVIDER_virtual/kernel = "linux-ea"

PREFERRED_PROVIDER_linux-mfgtool = "mfgtool-linux-ea"

KERNEL_DEVICETREE = "imx6dlea-com-kit.dtb"


PREFERRED_PROVIDER_u-boot = "u-boot-ea"
PREFERRED_PROVIDER_u-boot_mx6 = "u-boot-ea"
PREFERRED_PROVIDER_virtual/bootloader_imx = "u-boot-ea"

PREFERRED_PROVIDER_u-boot-mfgtool = "u-boot-ea-mfgtool"

UBOOT_CONFIG ??= "sd"
UBOOT_CONFIG[sd] = "mx6dlea-com_config"
UBOOT_CONFIG[mfgtool] = "mx6dlea-com-mfg_config"

UBOOT_MAKE_TARGET = "all"

UBOOT_SUFFIX = "${@bb.utils.contains("UBOOT_CONFIG", "mfgtool", "imx", "img",d)}"
SPL_BINARY = "${@bb.utils.contains("UBOOT_CONFIG", "mfgtool", "", "SPL",d)}"
```

## conf/machine/imx6qea-com.conf
```bitbake
#@TYPE: Machine
#@NAME: Embedded Artists i.MX6 Quad COM Board
#@SOC: i.MX6Q
#@DESCRIPTION: Machine configuration for Embedded Artists i.MX6 Quad COM Board
#@MAINTAINER: EA <imx@EmbeddedArtists.com>

require conf/machine/include/imx-base.inc
require conf/machine/include/tune-cortexa9.inc

MACHINEOVERRIDES =. "mx6:mx6q:"

PREFERRED_PROVIDER_virtual/kernel_imx = "linux-ea"
PREFERRED_PROVIDER_virtual/kernel = "linux-ea"

PREFERRED_PROVIDER_linux-mfgtool = "mfgtool-linux-ea"

KERNEL_DEVICETREE = "imx6qea-com-kit.dtb imx6qea-com-kit-ov5640.dtb"

PREFERRED_PROVIDER_u-boot = "u-boot-ea"
PREFERRED_PROVIDER_u-boot_mx6 = "u-boot-ea"
PREFERRED_PROVIDER_virtual/bootloader_imx = "u-boot-ea"

PREFERRED_PROVIDER_u-boot-mfgtool = "u-boot-ea-mfgtool"


UBOOT_CONFIG ??= "sd"
UBOOT_CONFIG[sd] = "mx6qea-com_config"
UBOOT_CONFIG[mfgtool] = "mx6qea-com-mfg_config"

UBOOT_MAKE_TARGET = "all"

UBOOT_SUFFIX = "${@bb.utils.contains("UBOOT_CONFIG", "mfgtool", "imx", "img",d)}"
SPL_BINARY = "${@bb.utils.contains("UBOOT_CONFIG", "mfgtool", "", "SPL",d)}"
```

## conf/machine/imx6sxea-com.conf
```bitbake
#@TYPE: Machine
#@NAME: Embedded Artists i.MX6 SoloX COM Board
#@SOC: i.MX6SX
#@DESCRIPTION: Machine configuration for Embedded Artists i.MX6 SoloX COM Board
#@MAINTAINER: EA <imx@EmbeddedArtists.com>

require conf/machine/include/imx-base.inc
require conf/machine/include/tune-cortexa9.inc

SERIAL_CONSOLE = "115200 ttymxc0"

MACHINEOVERRIDES =. "mx6:mx6sx:"

PREFERRED_PROVIDER_virtual/kernel_imx = "linux-ea"
PREFERRED_PROVIDER_virtual/kernel = "linux-ea"

PREFERRED_PROVIDER_linux-mfgtool = "mfgtool-linux-ea"

KERNEL_DEVICETREE = "imx6sxea-com-kit.dtb imx6sxea-com-kit-m4.dtb imx6sxea-com-kit-lvds.dtb imx6sxea-com-kit-rgb.dtb imx6sxea-com-kit-ov5640-pl.dtb"

PREFERRED_PROVIDER_u-boot = "u-boot-ea"
PREFERRED_PROVIDER_u-boot_mx6 = "u-boot-ea"
PREFERRED_PROVIDER_virtual/bootloader_imx = "u-boot-ea"

PREFERRED_PROVIDER_u-boot-mfgtool = "u-boot-ea-mfgtool"

UBOOT_CONFIG ??= "sd"
UBOOT_CONFIG[sd] = "mx6sxea-com_config"
UBOOT_CONFIG[mfgtool] = "mx6sxea-com-mfg_config"

UBOOT_MAKE_TARGET = "all"

UBOOT_SUFFIX = "${@bb.utils.contains("UBOOT_CONFIG", "mfgtool", "imx", "img",d)}"
SPL_BINARY = "${@bb.utils.contains("UBOOT_CONFIG", "mfgtool", "", "SPL",d)}"
```

## conf/machine/imx6ulea-com.conf
```bitbake
#@TYPE: Machine
#@NAME: Embedded Artists i.MX6 UltraLite COM Board
#@SOC: i.MX6UL
#@DESCRIPTION: Machine configuration for Embedded Artists i.MX6 UltraLite COM Board
#@MAINTAINER: EA <imx@EmbeddedArtists.com>

include conf/machine/include/imx-base.inc
include conf/machine/include/tune-cortexa7.inc

SERIAL_CONSOLES = "115200;ttymxc0"

MACHINE_FEATURES += " pci wifi bluetooth nxp8987 mrvl8997"

MACHINEOVERRIDES =. "mx6:mx6ul:"

PREFERRED_PROVIDER_virtual/kernel_imx = "linux-ea"
PREFERRED_PROVIDER_virtual/kernel = "linux-ea"

PREFERRED_PROVIDER_linux-mfgtool = "linux-ea-mfgtool"

KERNEL_DEVICETREE = "imx6ulea-com-kit_v2.dtb \
  imx6ulea-com-kit_v2-ov5640-pl.dtb \
  imx6ulea-com-ptp.dtb \
"

PREFERRED_PROVIDER_u-boot = "u-boot-ea"
PREFERRED_PROVIDER_u-boot_mx6ul = "u-boot-ea"
PREFERRED_PROVIDER_virtual/bootloader_imx = "u-boot-ea"

PREFERRED_PROVIDER_u-boot-mfgtool = "u-boot-ea-mfgtool"
PREFERRED_PROVIDER_u-boot-fw-utils = "u-boot-ea-fw-utils"

UBOOT_CONFIG ??= "sd"
UBOOT_CONFIG[sd] = "mx6ulea-com_config,sdcard"
UBOOT_CONFIG[mfgtool] = "mx6ulea-com_config"

UBOOT_MAKE_TARGET = "${@bb.utils.contains("UBOOT_CONFIG", "mfgtool", "u-boot.imx", "all",d)}"
UBOOT_SUFFIX = "${@bb.utils.contains("UBOOT_CONFIG", "mfgtool", "imx", "img",d)}"
SPL_BINARY = "${@bb.utils.contains("UBOOT_CONFIG", "mfgtool", "", "SPL",d)}"

#
# Got the following build error: "make_dtb_boot_files No such file or directory"
# Seemed to be related to imx-base.inc where make_dtb_boot_files is called from
# IMAGE_BOOT_FILES. Setting IMAGE_BOOT_FILES like below solved the problem, but
# it needs further investigation.
#
IMAGE_BOOT_FILES = " \
    ${KERNEL_IMAGETYPE} \
    ${KERNEL_DEVICETREE} \
"

# wic support
IMAGE_BOOT_FILES_append = " \
        boot.scr \
"
WKS_FILE_DEPENDS += " \
        u-boot-script-ea \
        e2fsprogs-native \
        bmap-tools-native \
"
WKS_FILE = "imx-uboot-spl-bootpart.wks.in"
```

## conf/machine/imx7dea-com.conf
```bitbake
#@TYPE: Machine
#@NAME: Embedded Artists i.MX7 Dual COM Board
#@SOC: i.MX7D
#@DESCRIPTION: Machine configuration for Embedded Artists i.MX7 Dual COM Board
#@MAINTAINER: EA <imx@EmbeddedArtists.com>

include conf/machine/include/imx-base.inc
include conf/machine/include/tune-cortexa7.inc

SERIAL_CONSOLES = "115200;ttymxc0"

MACHINE_FEATURES += " pci wifi bluetooth nxp8987 mrvl8997"

MACHINEOVERRIDES =. "mx7:mx7d:"

PREFERRED_PROVIDER_virtual/kernel_imx = "linux-ea"
PREFERRED_PROVIDER_virtual/kernel = "linux-ea"

PREFERRED_PROVIDER_linux-mfgtool = "linux-ea-mfgtool"

KERNEL_DEVICETREE = "imx7dea-com-kit_v2.dtb \
  imx7dea-com-kit_v2-m4.dtb \
  imx7dea-com-kit_v2-ov5640.dtb \
  imx7dea-com-kit_v2-pcie.dtb \
  imx7dea-com-ptp.dtb \
"

PREFERRED_PROVIDER_u-boot = "u-boot-ea"
PREFERRED_PROVIDER_u-boot_mx7 = "u-boot-ea"
PREFERRED_PROVIDER_virtual/bootloader_imx = "u-boot-ea"

PREFERRED_PROVIDER_u-boot-mfgtool = "u-boot-ea-mfgtool"
PREFERRED_PROVIDER_u-boot-fw-utils = "u-boot-ea-fw-utils"

UBOOT_CONFIG ??= "sd"
UBOOT_CONFIG[sd] = "mx7dea-com_config"
UBOOT_CONFIG[mfgtool] = "mx7dea-com_config"

XSERVER += "mesa-driver-swrast"

UBOOT_MAKE_TARGET = "${@bb.utils.contains("UBOOT_CONFIG", "mfgtool", "u-boot.imx", "all",d)}"
UBOOT_SUFFIX = "${@bb.utils.contains("UBOOT_CONFIG", "mfgtool", "imx", "img",d)}"
SPL_BINARY = "${@bb.utils.contains("UBOOT_CONFIG", "mfgtool", "", "SPL",d)}"

#
# Got the following build error: "make_dtb_boot_files No such file or directory"
# Seemed to be related to imx-base.inc where make_dtb_boot_files is called from
# IMAGE_BOOT_FILES. Setting IMAGE_BOOT_FILES like below solved the problem, but
# it needs further investigation.
#
IMAGE_BOOT_FILES = " \
    ${KERNEL_IMAGETYPE} \
    ${KERNEL_DEVICETREE} \
"

# wic support
IMAGE_BOOT_FILES_append = " \
        boot.scr \
"
WKS_FILE_DEPENDS += " \
        u-boot-script-ea \
        e2fsprogs-native \
        bmap-tools-native \
"
WKS_FILE = "imx-uboot-spl-bootpart.wks.in"
```

## conf/machine/imx7dea-ucom.conf
```bitbake
#@TYPE: Machine
#@NAME: Embedded Artists i.MX7 Dual uCOM Board
#@SOC: i.MX7D
#@DESCRIPTION: Machine configuration for Embedded Artists i.MX7 Dual uCOM Board
#@MAINTAINER: EA <imx@EmbeddedArtists.com>

MACHINEOVERRIDES =. "mx7:mx7d:"

require conf/machine/include/imx-base.inc
require conf/machine/include/tune-cortexa7.inc

SERIAL_CONSOLES = "115200;ttymxc0"

MACHINE_FEATURES += " pci wifi bluetooth nxp8987 mrvl8997"


PREFERRED_PROVIDER_virtual/kernel_imx = "linux-ea"
PREFERRED_PROVIDER_virtual/kernel = "linux-ea"

PREFERRED_PROVIDER_linux-mfgtool = "linux-ea-mfgtool"

KERNEL_DEVICETREE = "imx7dea-ucom-kit_v2.dtb \
  imx7dea-ucom-kit_v2-m4.dtb \
  imx7dea-ucom-kit_v2-ov5640.dtb \
  imx7dea-ucom-kit_v2-pcie.dtb \
  imx7dea-ucom-ptp.dtb \
"

PREFERRED_PROVIDER_u-boot = "u-boot-ea"
PREFERRED_PROVIDER_u-boot_mx7 = "u-boot-ea"
PREFERRED_PROVIDER_virtual/bootloader_imx = "u-boot-ea"

PREFERRED_PROVIDER_u-boot-mfgtool = "u-boot-ea-mfgtool"
PREFERRED_PROVIDER_u-boot-fw-utils = "u-boot-ea-fw-utils"

UBOOT_CONFIG ??= "sd"
UBOOT_CONFIG[sd] = "mx7dea-ucom_config"
UBOOT_CONFIG[mfgtool] = "mx7dea-ucom-ptp_config"

UBOOT_MAKE_TARGET = "${@bb.utils.contains("UBOOT_CONFIG", "mfgtool", "u-boot.imx", "all",d)}"
UBOOT_SUFFIX = "${@bb.utils.contains("UBOOT_CONFIG", "mfgtool", "imx", "img",d)}"
SPL_BINARY = "${@bb.utils.contains("UBOOT_CONFIG", "mfgtool", "", "SPL",d)}"

#
# Got the following build error: "make_dtb_boot_files No such file or directory"
# Seemed to be related to imx-base.inc where make_dtb_boot_files is called from
# IMAGE_BOOT_FILES. Setting IMAGE_BOOT_FILES like below solved the problem, but
# it needs further investigation.
#
IMAGE_BOOT_FILES = " \
    ${KERNEL_IMAGETYPE} \
    ${KERNEL_DEVICETREE} \
"

# wic support
IMAGE_BOOT_FILES_append = " \
        boot.scr \
"
WKS_FILE_DEPENDS += " \
        u-boot-script-ea \
        e2fsprogs-native \
        bmap-tools-native \
"
WKS_FILE = "imx-uboot-spl-bootpart.wks.in"
```

## conf/machine/imx7ulpea-ucom.conf
```bitbake
#@TYPE: Machine
#@NAME: Embedded Artists i.MX7 ULP uCOM Board
#@SOC: i.MX7D
#@DESCRIPTION: Machine configuration for Embedded Artists i.MX7 ULP uCOM Board
#@MAINTAINER: EA <imx@EmbeddedArtists.com>

MACHINEOVERRIDES =. "mx7:mx7ulp:"

require conf/machine/include/imx-base.inc
require conf/machine/include/tune-cortexa7.inc

SERIAL_CONSOLES = "115200;ttyLP0"

MACHINE_FEATURES += " pci wifi bluetooth nxp8987 mrvl8997"


PREFERRED_PROVIDER_virtual/kernel_imx = "linux-ea"
PREFERRED_PROVIDER_virtual/kernel = "linux-ea"

PREFERRED_PROVIDER_linux-mfgtool = "linux-ea-mfgtool"

KERNEL_DEVICETREE = "imx7ulpea-ucom-kit_v2.dtb \
                     imx7ulpea-ucom-kit_v2-1lv.dtb \
                     imx7ulpea-ucom-ptp.dtb \
                     imx7ulpea-ucom-ptp-1lv.dtb \
"

PREFERRED_PROVIDER_u-boot = "u-boot-ea"
PREFERRED_PROVIDER_u-boot_mx7 = "u-boot-ea"
PREFERRED_PROVIDER_virtual/bootloader_imx = "u-boot-ea"

PREFERRED_PROVIDER_u-boot-mfgtool = "u-boot-ea-mfgtool"
PREFERRED_PROVIDER_u-boot-fw-utils = "u-boot-ea-fw-utils"

UBOOT_CONFIG ??= "sd"
UBOOT_CONFIG[sd] = "mx7ulpea-ucom_config,sdcard"
UBOOT_CONFIG[mfgtool] = "mx7ulpea-ucom_config"

UBOOT_MAKE_TARGET = "u-boot.imx"
UBOOT_SUFFIX = "imx"

#
# Got the following build error: "make_dtb_boot_files No such file or directory"
# Seemed to be related to imx-base.inc where make_dtb_boot_files is called from
# IMAGE_BOOT_FILES. Setting IMAGE_BOOT_FILES like below solved the problem, but
# it needs further investigation.
#
IMAGE_BOOT_FILES = " \
    ${KERNEL_IMAGETYPE} \
    ${KERNEL_DEVICETREE} \
"

# wic support
IMAGE_BOOT_FILES_append = " \
        boot.scr \
"
WKS_FILE_DEPENDS += " \
        u-boot-script-ea \
        e2fsprogs-native \
        bmap-tools-native \
"
```

## conf/machine/imx8mnea-ucom.conf
```bitbake
#@TYPE: Machine
#@NAME: Embedded Artists i.MX8M Nano uCOM Board
#@SOC: i.MX8MN
#@DESCRIPTION: Machine configuration for Embedded Artists i.MX8M Nano uCOM Board
#@MAINTAINER: EA <imx@embeddedartists.com>

MACHINEOVERRIDES =. "mx8:mx8m:mx8mn:"

require conf/machine/include/imx-base.inc
require conf/machine/include/tune-cortexa53.inc

PREFERRED_PROVIDER_virtual/kernel_imx = "linux-ea"
PREFERRED_PROVIDER_virtual/kernel = "linux-ea"

PREFERRED_PROVIDER_u-boot = "u-boot-ea"
PREFERRED_PROVIDER_virtual/bootloader_imx = "u-boot-ea"
PREFERRED_PROVIDER_u-boot-mfgtool = "u-boot-ea-mfgtool"
PREFERRED_PROVIDER_u-boot-fw-utils = "u-boot-ea-fw-utils"

MACHINE_FEATURES += " pci nxp8987 mrvl8997"

KERNEL_DEVICETREE = "freescale/imx8mn-ea-ucom-kit_v2.dtb \
                     freescale/imx8mn-ea-ucom-kit_v2-1mw.dtb \
                     freescale/imx8mn-ea-ucom-kit_v2-m4.dtb \
                     freescale/imx8mn-ea-ucom-kit_v2-usb-host.dtb \
                     freescale/imx8mn-ea-ucom-kit_v2-ov5640.dtb \
                     freescale/imx8mn-ea-ucom-ptp.dtb \
                     freescale/imx8mn-ea-ucom-ptp-1mw.dtb \
"

IMAGE_BOOTFILES_DEPENDS += "imx-m7-demos:do_deploy"
IMAGE_BOOTFILES += "imx8mn_m7_TCM_hello_world.bin \
                    imx8mn_m7_TCM_rpmsg_lite_pingpong_rtos_linux_remote.bin \
                    imx8mn_m7_TCM_rpmsg_lite_str_echo_rtos.bin \
                    imx8mn_m7_TCM_sai_low_power_audio.bin \
"

UBOOT_CONFIG ??= "sd"
UBOOT_CONFIG[sd] = "mx8mnea-ucom_config,sdcard"
SPL_BINARY = "spl/u-boot-spl.bin"

# Set DDR FIRMWARE
DDR_FIRMWARE_NAME = "ddr4_imem_1d_201810.bin ddr4_dmem_1d_201810.bin ddr4_imem_2d_201810.bin ddr4_dmem_2d_201810.bin"

# Set u-boot DTB
UBOOT_DTB_NAME = "imx8mn-ea-ucom-kit_v2.dtb"

# Set imx-mkimage boot target
IMXBOOT_TARGETS = "flash_ddr4_evk"

# Set Serial console
SERIAL_CONSOLES = "115200;ttymxc1"

IMAGE_BOOTLOADER = "imx-boot"

BOOT_SPACE = "65536"

LOADADDR = ""
UBOOT_SUFFIX = "bin"
UBOOT_MAKE_TARGET = ""
IMX_BOOT_SEEK = "33"

# wic support
IMAGE_BOOT_FILES_append = " \
        boot.scr \
"
WKS_FILE_DEPENDS += " \
        u-boot-script-ea \
        e2fsprogs-native \
        bmap-tools-native \
"
```

## conf/machine/imx8mqea-com.conf
```bitbake
#@TYPE: Machine
#@NAME: Embedded Artists i.MX8MQ COM Board
#@SOC: i.MX8MQ
#@DESCRIPTION: Machine configuration for Embedded Artists i.MX8MQ COM Board
#@MAINTAINER: EA <imx@embeddedartists.com>

MACHINEOVERRIDES =. "mx8:mx8m:mx8mq:"

require conf/machine/include/imx-base.inc
require conf/machine/include/tune-cortexa53.inc

PREFERRED_PROVIDER_virtual/kernel_imx = "linux-ea"
PREFERRED_PROVIDER_virtual/kernel = "linux-ea"

PREFERRED_PROVIDER_u-boot = "u-boot-ea"
PREFERRED_PROVIDER_virtual/bootloader_imx = "u-boot-ea"
PREFERRED_PROVIDER_u-boot-mfgtool = "u-boot-ea-mfgtool"
PREFERRED_PROVIDER_u-boot-fw-utils = "u-boot-ea-fw-utils"

MACHINE_FEATURES += " pci nxp8987 mrvl8997"

KERNEL_DEVICETREE = "freescale/imx8mq-ea-com-kit_v2.dtb \
                     freescale/imx8mq-ea-com-kit_v2-m4.dtb \
                     freescale/imx8mq-ea-com-kit_v2-pcie.dtb \
                     freescale/imx8mq-ea-com-kit_v2-ov5640.dtb \
                     freescale/imx8mq-ea-com-kit_v2-mfg.dtb \
                     freescale/imx8mq-ea-com-ptp.dtb \
"

IMAGE_BOOTFILES_DEPENDS += "imx-m4-demos:do_deploy"
IMAGE_BOOTFILES += "imx8mq_m4_TCM_hello_world.bin imx8mq_m4_TCM_rpmsg_lite_pingpong_rtos_linux_remote.bin imx8mq_m4_TCM_rpmsg_lite_str_echo_rtos.bin"

UBOOT_CONFIG ??= "sd"
UBOOT_CONFIG[sd] = "mx8mqea-com_config,sdcard"
SPL_BINARY = "spl/u-boot-spl.bin"

# Set DDR FIRMWARE
DDR_FIRMWARE_NAME = "lpddr4_pmu_train_1d_imem.bin lpddr4_pmu_train_1d_dmem.bin lpddr4_pmu_train_2d_imem.bin lpddr4_pmu_train_2d_dmem.bin"

# Set u-boot DTB
UBOOT_DTB_NAME = "imx8mq-ea-com-kit_v2.dtb"

# Set imx-mkimage boot target
IMXBOOT_TARGETS = "flash_evk flash_evk_no_hdmi flash_dp_evk"

# Set Serial console
SERIAL_CONSOLES = "115200;ttymxc0"

IMAGE_BOOTLOADER = "imx-boot"

BOOT_SPACE = "65536"

LOADADDR = ""
UBOOT_SUFFIX = "bin"
UBOOT_MAKE_TARGET = ""
IMX_BOOT_SEEK = "33"

# wic support
IMAGE_BOOT_FILES_append = " \
        boot.scr \
"
WKS_FILE_DEPENDS += " \
        u-boot-script-ea \
        e2fsprogs-native \
        bmap-tools-native \
"
```
