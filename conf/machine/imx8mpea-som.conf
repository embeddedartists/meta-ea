## conf/machine/imx8mpea-som.conf
```bitbake
#@TYPE: Machine
#@NAME: Embedded Artists i.MX8MP SOM Board
#@SOC: i.MX8MP
#@DESCRIPTION: Machine configuration for Embedded Artists i.MX8MP SOM Board
#@MAINTAINER: EA <imx@embeddedartists.com>

MACHINEOVERRIDES =. "mx8mp:"


require conf/machine/include/imx-base.inc
require conf/machine/include/arm/armv8a/tune-cortexa53.inc

UBOOT_PROVIDES_BOOT_CONTAINER = "0"
UBOOT_PROVIDES_BOOT_CONTAINER:mx8m-generic-bsp = "0"

PREFERRED_PROVIDER_virtual/kernel:imx-nxp-bsp = "linux-ea"
PREFERRED_PROVIDER_virtual/kernel = "linux-ea"
PREFERRED_RPROVIDER_kernel-module-imx-gpu-viv = "linux-ea"

PREFERRED_PROVIDER_u-boot = "u-boot-ea"
PREFERRED_PROVIDER_virtual/bootloader:imx-nxp-bsp = "u-boot-ea"
PREFERRED_PROVIDER_u-boot-mfgtool = "u-boot-ea-mfgtool"
PREFERRED_PROVIDER_u-boot-fw-utils = "u-boot-ea-fw-utils"

MACHINE_FEATURES += " pci nxp8987 mrvl8997"

KERNEL_DEVICETREE = "freescale/imx8mp-ea-som-kit.dtb \
                     freescale/imx8mp-ea-som-kit-deepx.dtb \
                     freescale/imx8mp-ea-som-kit-m7.dtb \
                     freescale/imx8mp-ea-som-kit-ov5640.dtb \
                     freescale/imx8mp-ea-som-kit-pcie-bkey.dtb \
                     freescale/imx8mp-ea-som-kit-pcie-ekey.dtb \
                     freescale/imx8mp-ea-som-kit-pcie-mkey.dtb \
"

IMAGE_BOOT_FILES:append:imx-nxp-bsp = " \
    mcore-demos/imx8mp_m7_TCM_hello_world.bin \
    mcore-demos/imx8mp_m7_TCM_rpmsg_lite_pingpong_rtos_linux_remote.bin \
    mcore-demos/imx8mp_m7_TCM_rpmsg_lite_str_echo_rtos.bin \
    mcore-demos/imx8mp_m7_TCM_sai_low_power_audio.bin \
"

UBOOT_CONFIG ??= "sd"
UBOOT_CONFIG[sd] = "mx8mpea-som_config,sdcard"
UBOOT_CONFIG[mfgtool] = "mx8mpea-som_config"
SPL_BINARY = "spl/u-boot-spl.bin"

ATF_PLATFORM = "imx8mp"

# Set DDR FIRMWARE
DDR_FIRMWARE_VERSION = "202006"
DDR_FIRMWARE_NAME = " \
    lpddr4_pmu_train_1d_dmem_${DDR_FIRMWARE_VERSION}.bin \
    lpddr4_pmu_train_1d_imem_${DDR_FIRMWARE_VERSION}.bin \
    lpddr4_pmu_train_2d_dmem_${DDR_FIRMWARE_VERSION}.bin \
    lpddr4_pmu_train_2d_imem_${DDR_FIRMWARE_VERSION}.bin \
"

# Set u-boot DTB
UBOOT_DTB_NAME = "imx8mp-ea-som-kit.dtb"

# Set imx-mkimage boot target
IMXBOOT_TARGETS = "flash_evk"

IMX_BOOT_SOC_TARGET = "iMX8MP"

# Set Serial console
SERIAL_CONSOLES = "115200;ttymxc1"

LOADADDR = ""
UBOOT_SUFFIX = "bin"
UBOOT_MAKE_TARGET = "all"
IMX_BOOT_SEEK = "32"

# wic support
IMAGE_BOOT_FILES:append = " \
        boot.scr \
"

WKS_FILE_DEPENDS:append = " imx-m7-demos"
WKS_FILE_DEPENDS:append = " u-boot-script-ea"
```

## conf/machine/imx93ea-ucom.conf
```bitbake
#@TYPE: Machine
#@NAME: Embedded Artists i.MX93 uCOM Board
#@SOC: i.MX93
#@DESCRIPTION: Machine configuration for Embedded Artists i.MX93 uCOM Board
#@MAINTAINER: EA <imx@embeddedartists.com>

MACHINEOVERRIDES =. "mx93:"

require conf/machine/include/imx-base.inc
require conf/machine/include/arm/armv8-2a/tune-cortexa55.inc

KERNEL_DEVICETREE_BASENAME = "imx93-ea-ucom-kit"


PREFERRED_PROVIDER_virtual/kernel:imx-nxp-bsp = "linux-ea"
PREFERRED_PROVIDER_virtual/kernel = "linux-ea"

PREFERRED_PROVIDER_u-boot = "u-boot-ea"
PREFERRED_PROVIDER_virtual/bootloader:imx-nxp-bsp = "u-boot-ea"
PREFERRED_PROVIDER_u-boot-mfgtool = "u-boot-ea-mfgtool"
PREFERRED_PROVIDER_u-boot-fw-utils = "u-boot-ea-fw-utils"

MACHINE_FEATURES += " pci wifi bluetooth"

KERNEL_DEVICETREE = " \
	freescale/${KERNEL_DEVICETREE_BASENAME}.dtb \
	freescale/${KERNEL_DEVICETREE_BASENAME}-m33.dtb \
	freescale/${KERNEL_DEVICETREE_BASENAME}-2ea.dtb \
"

UBOOT_CONFIG_BASENAME = "mx93ea-ucom"

UBOOT_DTB_NAME = "${KERNEL_DEVICETREE_BASENAME}.dtb"

LOADADDR = ""
UBOOT_SUFFIX = "bin"
UBOOT_MAKE_TARGET = ""

SPL_BINARY = "spl/u-boot-spl.bin"

UBOOT_CONFIG ??= "sd"
UBOOT_CONFIG[sd]   = "${UBOOT_CONFIG_BASENAME}_defconfig,sdcard"
UBOOT_CONFIG[mfgtool] = "${UBOOT_CONFIG_BASENAME}_defconfig"

# Set ATF platform name
ATF_PLATFORM = "imx93"

IMXBOOT_TARGETS = "flash_singleboot"

IMX_BOOT_SOC_TARGET = "iMX9"
IMX_BOOT_SEEK = "32"

SERIAL_CONSOLES = "115200;ttyLP0"

# Add additional firmware
MACHINE_FIRMWARE:append = " ethos-u-firmware"

DDR_FIRMWARE_NAME = " \
        lpddr4_dmem_1d_v202201.bin \
        lpddr4_dmem_2d_v202201.bin \
        lpddr4_imem_1d_v202201.bin \
        lpddr4_imem_2d_v202201.bin \
"

# wic support
IMAGE_BOOT_FILES:append = " \
	boot.scr \
"

WKS_FILE_DEPENDS:append = " imx-m33-demos"
WKS_FILE_DEPENDS:append = " u-boot-script-ea"
```
